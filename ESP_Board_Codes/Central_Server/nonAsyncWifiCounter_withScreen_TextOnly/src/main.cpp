#if defined(ESP8266)
#include <ESP8266WiFi.h>
#include <ESPAsyncTCP.h>

#elif defined(ESP32)
#include <WiFi.h>
#include <AsyncTCP.h>
#endif

#include <WiFiManager.h>
WiFiManager wm;

#define WEBSERVER_H
#include <ESPAsyncWebServer.h>
#include <WebSocketsServer.h>
#include <ArduinoJson.h>

#include <Adafruit_GFX.h>
#include <Fonts/FreeSans9pt7b.h>
#include <Adafruit_SSD1306.h>
#include <Wire.h>

#define SCREEN_WIDTH 128
#define SCREEN_HEIGHT 64
#define OLED_RESET -1
#define SCREEN_ADDRESS 0x3C ///< See datasheet for Address; 0x3D for 128x64, 0x3C for 128x32

const int playerCount = 2;

#pragma region icon
// 'favicon', 128x64px
static const unsigned char PROGMEM logo_bmp[] =  {
	0xff, 0xff, 0xff, 0xff, 0xff, 0xff, 0xff, 0xff, 0xff, 0xff, 0xff, 0xff, 0xff, 0xff, 0xff, 0xff, 
	0xff, 0xff, 0xff, 0xff, 0xff, 0xff, 0xff, 0xff, 0xff, 0xff, 0xff, 0xff, 0xff, 0xff, 0xff, 0xff, 
	0xff, 0xff, 0xff, 0xff, 0xff, 0xff, 0xff, 0xff, 0xff, 0xff, 0xff, 0xff, 0xff, 0xff, 0xff, 0xff, 
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	0xff, 0xff, 0xff, 0xff, 0xff, 0xff, 0xff, 0xff, 0xff, 0xff, 0xff, 0xff, 0xff, 0xff, 0xff, 0xff
};

// Array of all bitmaps for convenience. (Total bytes used to store images in PROGMEM = 1040)

#pragma endregion

Adafruit_SSD1306 display(SCREEN_WIDTH, SCREEN_HEIGHT, &Wire, OLED_RESET);

const char *MESSAGE_CONFIGURE_WIFI[4] = {"Scan QR", "to setup", "WiFi", ""};
const char *MESSAGE_OPEN_WEBAPP[4] = {"Scan QR", "to open", "race manager", "webapp "};

const char *SLOT_STATUS = "slot_status";
const char *MILLIS = "millis";
const char *THRESHOLD = "threshold";

WebSocketsServer webSocket(80, "*");
String chipModel;
unsigned long startTime;
int threshold = 100;

const char *wifiPassword = "admin1234";
String wifiName;

const int cursor_start_y = 15;
const int cursor_start_x = 0;
const int font_height = 15;

AsyncWebServer server(81);

#pragma region HtmlCode

const char* htmlPage = R"rawliteral(
<!DOCTYPE html>
<html lang="en">

<head>
    <meta charset="UTF-8">
    <meta name="viewport" content="width=device-width, initial-scale=1.0">
    <title>Arduino Tester</title>
    <link rel="stylesheet" href="https://unpkg.com/mvp.css">
</head>

<body>
    <main>
        <header>
            <h1>WebSocket Tester</h1>
            <h3 id="socketIp"></h3>
        </header>
        <div>
            <button id="pingButton">Send Ping</button>
        </div>
        <h2>Messages:</h2>
        <section>
            <table>
                <thead>
                    <tr>
                        <th>Timestamp</th>
                        <th>Message</th>
                    </tr>
                </thead>
                <tbody id="messages"></tbody>
            </table>
        </section>
    </main>

    <script>
        const socketIp = 'ws://' + window.location.hostname + ':80';
        document.getElementById('socketIp').textContent = socketIp;

        const socket = new WebSocket(socketIp);

        socket.onopen = function () {
            console.log('WebSocket connection established');
        };

        function appendMessage(message) {
            const messagesTable = document.getElementById('messages');
            const newRow = document.createElement('tr');
            const timestampCell = document.createElement('td');
            const messageCell = document.createElement('td');
            const timestamp = new Date().toLocaleString();

            timestampCell.textContent = timestamp;
            messageCell.textContent = message;

            newRow.appendChild(timestampCell);
            newRow.appendChild(messageCell);
            messagesTable.appendChild(newRow);
        }

        socket.onmessage = function (event) {
            appendMessage(event.data);
        };

        socket.onclose = function () {
            appendMessage('WebSocket connection closed');
        };

        socket.onerror = function (error) {
            console.error('WebSocket error:', error);
        };

        document.getElementById('pingButton').addEventListener('click', function () {
            socket.send('Ping');
        });
    </script>
</body>

</html>
)rawliteral";

#pragma endregion

void setupScreen();
void setupWebSocket();
void setupWifi();
void configModeCallback(WiFiManager *myWiFiManager);
void webSocketEvent(uint8_t num, WStype_t type, uint8_t *payload, size_t length);
void handleWebSocketMessage(uint8_t num, uint8_t *payload, size_t length);
void notifyClients(String sensorReadings);
StaticJsonDocument<96> getJsonSensorData();
String getJsonInfo();
void resetScreen();
void drawTexts(const char *lines[]);

void setup()
{
  Serial.begin(115200);
  setupScreen();

#if defined(ESP8266)
  chipModel = "ESP8266";
#else // ESP32
  chipModel = "ESP32";
#endif

  Serial.println(chipModel);
  setupWifi();
  setupWebSocket();

  server.on("/", HTTP_GET, [](AsyncWebServerRequest *request){
    Serial.println("Main page requested");
    request->send_P(200, "text/html", htmlPage);
  });

  // Start the server
  server.begin();
}

void setupScreen()
{
  Wire.begin(14, 12);
  if (!display.begin(SSD1306_SWITCHCAPVCC, SCREEN_ADDRESS))
  {
    Serial.println(F("SSD1306 allocation failed"));
    for (;;)
      ; // Don't proceed, loop forever
  }
  display.setTextColor(1, 0);
  display.clearDisplay();
  display.setFont(&FreeSans9pt7b);
  display.drawBitmap(0, 0, logo_bmp, SCREEN_WIDTH, SCREEN_HEIGHT, 1);
  display.display();
}

void setupWebSocket()
{
  webSocket.begin();
  webSocket.onEvent(webSocketEvent);
  Serial.println("Websocket started");
}

void setupWifi()
{
  bool res;

  long randNumber = random(100);
  wifiName = "RaceM-Server"; // + String(randNumber); // + String(randNumber);
  // wm.setSTAStaticIPConfig(IPAddress(192,168,1,99), IPAddress(192,168,1,1), IPAddress(255,255,255,0));
  wm.setAPCallback(configModeCallback);

  wm.setConfigPortalTimeout(180); // Timeout after 3 minutes
  wm.setBreakAfterConfig(true); //

  res = wm.autoConnect(wifiName.c_str(), wifiPassword);

  if (!res)
  {
    Serial.println("Failed to connect");
    ESP.restart();
  }
  else
  {
    Serial.println("Connected");
    Serial.println("Port: 81");
  }
  resetScreen();
  display.setCursor(cursor_start_x, cursor_start_y);
  display.println(F("IP address: "));
  display.setCursor(cursor_start_x, cursor_start_y + font_height);
  display.println(WiFi.localIP());
  display.println("Port: 81");
  display.display();
}

void configModeCallback(WiFiManager *myWiFiManager)
{
  Serial.println("Entered config mode");
  // Format the QR code string
  char qrCodeString[100]; // Adjust the size as needed
  snprintf(qrCodeString, sizeof(qrCodeString), "WIFI:S:%s;P:%s;;", wifiName, wifiPassword);
  const char *wifiInfo[4];
  wifiInfo[0] = "Wifi Name: ";
  wifiInfo[1] = wifiName.c_str();
  wifiInfo[2] = "Password: ";
  wifiInfo[3] = wifiPassword;
  // drawQrCode(qrCodeString, MESSAGE_CONFIGURE_WIFI);
  drawTexts(wifiInfo);
  Serial.println(WiFi.softAPIP());
  Serial.println(myWiFiManager->getConfigPortalSSID());
}

void webSocketEvent(uint8_t num, WStype_t type, uint8_t *payload, size_t length)
{
  switch (type)
  {
  case WStype_DISCONNECTED:
    Serial.printf("[%u] Disconnected!\n", num);
    break;
  case WStype_CONNECTED:
    Serial.printf("[%u] Connected from %s\n", num, webSocket.remoteIP(num).toString().c_str());
    break;
  case WStype_TEXT:
    handleWebSocketMessage(num, payload, length);
    break;
  }
}

void handleWebSocketMessage(uint8_t num, uint8_t *payload, size_t length)
{
  String message = (char *)payload;
  if (message == "Ping")
  {
    Serial.println(F("Sending Pong"));
    webSocket.sendTXT(num, "Pong");
    return;
  }
  StaticJsonDocument<96> doc;
  DeserializationError error = deserializeJson(doc, message);
  if (error)
  {
    Serial.println(F("deserializeJson() failed: "));
    Serial.println(error.f_str());
    return;
  }

  threshold = doc[THRESHOLD];
  Serial.print("New threshold: " + String(threshold));
}

void notifyClients(String sensorReadings)
{
  webSocket.broadcastTXT(sensorReadings);
}

StaticJsonDocument<96> previousReading;
bool isLongScreen;
void loop()
{
  unsigned long currentTime = millis();
  unsigned long elapsedTime = currentTime - startTime;

  if (elapsedTime >= 1000)
  {
    StaticJsonDocument<96> newReading;
    newReading["millis"] = String(millis());
    JsonArray slot_status = newReading.createNestedArray("slot_status");
    slot_status.add(true);
    slot_status.add(false);

    for (int i = 0; i < playerCount; i++)
    {
      if ((bool)newReading[SLOT_STATUS][i] != (bool)previousReading[SLOT_STATUS][i])
      {

        break;
      }
    }

    String result = "";
    serializeJson(newReading, result);
    // move up in production
    notifyClients(result);

    previousReading = newReading;
    Serial.println(F("One second has passed!"));
    Serial.println(currentTime);

    startTime = currentTime;
  }
  if (!isLongScreen && currentTime > 300000)
  {
    isLongScreen = true;
    display.clearDisplay();
  }
  webSocket.loop();
}

StaticJsonDocument<96> getJsonSensorData()
{
  StaticJsonDocument<96> doc;
  doc["millis"] = String(millis());
  JsonArray slot_status = doc.createNestedArray("slot_status");
  slot_status.add(true);
  slot_status.add(false);

  return doc;
}

String getJsonInfo()
{
  StaticJsonDocument<96> doc;
  doc["track_type"] = "Analog";
  doc["sensor_type"] = "Hall effect";
  doc["chip_Model"] = chipModel;

  String result = "";
  serializeJson(doc, result);
  return result;
}

void resetScreen()
{
  Serial.println(F("Start text drawing"));
  display.clearDisplay();
}

void drawTexts(const char *lines[])
{
  resetScreen();
  for (int i = 0; i < 4; i++)
  {
    display.setCursor(cursor_start_x, cursor_start_y + font_height * i);
    Serial.println(lines[i]);
    display.println(lines[i]);
  }
  display.display();
  Serial.println(F("Finish text drawing"));
}

